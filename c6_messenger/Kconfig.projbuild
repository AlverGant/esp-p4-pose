## c6_messenger/Kconfig.projbuild
```kconfig
menu "c6_messenger Configuration"

config WIFI_SSID
    string "Wi‑Fi SSID"
    default ""
    help
        Nome da rede Wi‑Fi para conectar (STA).

config WIFI_PASSWORD
    string "Wi‑Fi Password"
    default ""
    help
        Senha da rede Wi‑Fi (deixe vazio para redes OPEN).

config TELEGRAM_BOT_TOKEN
    string "Telegram Bot Token"
    default ""
    help
        Token do bot no formato 123456789:ABC... (NÃO comitar).

config TELEGRAM_CHAT_ID
    string "Telegram Chat ID"
    default ""
    help
        Chat ID de destino (usuário/grupo) para enviar mensagens.

config TELEGRAM_COOLDOWN_SEC
    int "Cooldown entre mensagens (s)"
    default 60
    range 0 86400

config UART_BAUD
    int "UART baud rate"
    default 115200
    range 1200 3000000

endmenu
```

## c6_messenger/main/Kconfig.projbuild
```kconfig
menu "Wi-Fi"

    config WIFI_SSID
        string "Wi-Fi SSID"
        default ""

    config WIFI_PASSWORD
        string "Wi-Fi Password"
        default ""

endmenu

menu "Telegram"

    config TELEGRAM_BOT_TOKEN
        string "Telegram Bot Token (botXXXX:token)"
        default ""

    config TELEGRAM_CHAT_ID
        string "Telegram Chat ID"
        default ""

    config TELEGRAM_COOLDOWN_SEC
        int "Cooldown entre mensagens (s)"
        default 60
        range 5 3600

endmenu

menu "ESP-Hosted Alerts"

    config HOSTED_ALERT_SERVER_ENABLE
        bool "Habilitar servidor HTTP para alertas do P4"
        default y

    config HOSTED_ALERT_SERVER_PORT
        int "Porta HTTP para receber alertas"
        default 8080
        range 1 65535
        depends on HOSTED_ALERT_SERVER_ENABLE

    config HOSTED_ALERT_MAX_BODY_LEN
        int "Tamanho máximo da mensagem (bytes)"
        default 256
        range 64 2048
        depends on HOSTED_ALERT_SERVER_ENABLE

endmenu

menu "UART Input"

    config UART_BAUD
        int "UART baud"
        default 115200
        range 9600 2000000

endmenu
```

## c6_messenger/sdkconfig.defaults
```kconfig
# Enable CA bundle for HTTPS (Telegram)
CONFIG_MBEDTLS_CERTIFICATE_BUNDLE=y
CONFIG_MBEDTLS_CERTIFICATE_BUNDLE_DEFAULT_FULL=y

# Configure UART0 console for logs output (TX only, RX handled by our code)
CONFIG_ESP_CONSOLE_UART=y
CONFIG_ESP_CONSOLE_UART_NUM=0
CONFIG_ESP_CONSOLE_UART_TX_GPIO=16
CONFIG_ESP_CONSOLE_UART_RX_GPIO=-1
CONFIG_ESP_CONSOLE_UART_BAUDRATE=115200
CONFIG_ESP_CONSOLE_SECONDARY_NONE=y

# Enable bootloader and app logs for debugging (they go to UART0 → P4 monitor)
CONFIG_BOOTLOADER_LOG_LEVEL_INFO=y
CONFIG_LOG_DEFAULT_LEVEL_INFO=y

# Disable HTTP server (not needed, using UART only)
CONFIG_HOSTED_ALERT_SERVER_ENABLE=n

# Custom partition table with larger app size
CONFIG_PARTITION_TABLE_CUSTOM=y
CONFIG_PARTITION_TABLE_CUSTOM_FILENAME="partitions.csv"
CONFIG_PARTITION_TABLE_FILENAME="partitions.csv"
```

## main/Kconfig.projbuild
```kconfig
menu "Example Configuration"

    config EXAMPLE_ENABLE_MIPI_CSI_CAM_SENSOR
        bool "Enable MIPI CSI Camera Sensor"
        default y
        depends on SOC_MIPI_CSI_SUPPORTED

    if EXAMPLE_ENABLE_MIPI_CSI_CAM_SENSOR
        config EXAMPLE_MIPI_CSI_SCCB_I2C_PORT
            int "MIPI CSI SCCB I2C Port Number"
            default 0
            range 0 1

        config EXAMPLE_MIPI_CSI_SCCB_I2C_SCL_PIN
            int "MIPI CSI SCCB I2C SCL Pin"
            default 34
            range -1 56

        config EXAMPLE_MIPI_CSI_SCCB_I2C_SDA_PIN
            int "MIPI CSI SCCB I2C SDA Pin"
            default 31
            range -1 56

        config EXAMPLE_MIPI_CSI_SCCB_I2C_FREQ
            int "MIPI CSI SCCB I2C Frequency"
            default 100000
            range 100000 400000

        config EXAMPLE_MIPI_CSI_CAM_SENSOR_RESET_PIN
            int "MIPI CSI Camera Sensor Reset Pin"
            default -1
            range -1 56

        config EXAMPLE_MIPI_CSI_CAM_SENSOR_PWDN_PIN
            int "MIPI CSI Camera Sensor Power Down Pin"
            default -1
            range -1 56
    endif

endmenu

# SDIO messenger removed; UART-only path enabled

menu "Network & Telegram"

    config WIFI_SSID
        string "Wi-Fi SSID"
        default ""

    config WIFI_PASSWORD
        string "Wi-Fi Password"
        default ""

    config TELEGRAM_ENABLE
        bool "Enable Telegram notifications"
        default n

    config TELEGRAM_BOT_TOKEN
        string "Telegram Bot Token (botXXXX:token)"
        default ""
        depends on TELEGRAM_ENABLE

    config TELEGRAM_CHAT_ID
        string "Telegram Chat ID"
        default ""
        depends on TELEGRAM_ENABLE

    config TELEGRAM_COOLDOWN_SEC
        int "Cooldown between messages (seconds)"
        default 60
        range 5 3600
        depends on TELEGRAM_ENABLE

endmenu

menu "ESP-AT Client (C6 Communication)"

    config AT_CLIENT_ENABLE
        bool "Enable ESP-AT client for C6 co-processor"
        default y
        depends on COPROC_UART_ENABLE
        help
            Enable AT command communication with ESP32-C6 running ESP-AT firmware.

    config AT_CLIENT_TIMEOUT_MS
        int "Default AT command timeout (ms)"
        default 5000
        range 1000 60000
        depends on AT_CLIENT_ENABLE

    config AT_CLIENT_CONNECT_TIMEOUT_MS
        int "WiFi/MQTT connect timeout (ms)"
        default 30000
        range 5000 120000
        depends on AT_CLIENT_ENABLE

    config AT_WIFI_AUTO_CONNECT
        bool "Auto-connect WiFi on startup"
        default y
        depends on AT_CLIENT_ENABLE

    config AT_MQTT_ENABLE
        bool "Enable MQTT via ESP-AT"
        default n
        depends on AT_CLIENT_ENABLE

    if AT_MQTT_ENABLE
        config AT_MQTT_BROKER_HOST
            string "MQTT Broker hostname"
            default "mqtt.example.com"

        config AT_MQTT_BROKER_PORT
            int "MQTT Broker port"
            default 1883
            range 1 65535

        config AT_MQTT_CLIENT_ID
            string "MQTT Client ID"
            default "esp32p4"

        config AT_MQTT_USERNAME
            string "MQTT Username (optional)"
            default ""

        config AT_MQTT_PASSWORD
            string "MQTT Password (optional)"
            default ""

        config AT_MQTT_TOPIC_FALL
            string "MQTT topic for fall events"
            default "home/fall"

        config AT_MQTT_TOPIC_STATUS
            string "MQTT topic for status"
            default "home/esp32p4/status"
    endif

    config AT_TELEGRAM_VIA_C6
        bool "Send Telegram via C6 (AT+HTTPCLIENT)"
        default y
        depends on AT_CLIENT_ENABLE && TELEGRAM_ENABLE
        help
            Use ESP-AT HTTP client on C6 to send Telegram messages
            instead of P4's WiFi stack.

endmenu

menu "Co-processor Messenger (UART)"

    config COPROC_UART_ENABLE
        bool "Enable UART messenger output"
        default y

    config COPROC_UART_NUM
        int "UART port number"
        default 2
        range 0 2
        depends on COPROC_UART_ENABLE

    config COPROC_UART_TX_PIN
        int "UART TX GPIO (P4 -> C6 RX)"
        default 35
        range -1 56
        depends on COPROC_UART_ENABLE

    config COPROC_UART_RX_PIN
        int "UART RX GPIO (optional)"
        default 36
        range -1 56
        depends on COPROC_UART_ENABLE

    config COPROC_UART_BAUD
        int "UART baud rate"
        default 115200
        range 9600 2000000
        depends on COPROC_UART_ENABLE

    config COPROC_MSG_TEMPLATE
        string "Message template on fall"
        default "FALL persons=%d age_ms=%d seq=%d"
        depends on COPROC_UART_ENABLE

    config COPROC_COOLDOWN_SEC
        int "UART message cooldown (seconds)"
        default 10
        range 1 3600
        depends on COPROC_UART_ENABLE

    config COPROC_LOG_TEST_ONLY
        bool "Only start co-processor UART logs (skip display/camera)"
        default n
        help
            Enable this to run a minimal app that only initializes the
            co-processor UART and prints C6 logs to the console. Useful
            for wiring/pin mux diagnostics without display/camera enabled.

endmenu

menu "C6 Flash Bridge"

    config C6_BRIDGE_ENABLE
        bool "Enable C6 flash bridge (USB<->UART)"
        default y

    config C6_BRIDGE_BTN_GPIO
        int "Trigger button GPIO (pressed at boot enters bridge)"
        default 3
        range 0 56
        depends on C6_BRIDGE_ENABLE

    config C6_EN_GPIO
        int "C6_EN GPIO (reset)"
        default 9
        range 0 56
        depends on C6_BRIDGE_ENABLE

    config C6_BOOT_GPIO
        int "C6_BOOT GPIO (boot strap)"
        default 34
        range 0 56
        depends on C6_BRIDGE_ENABLE

    config C6_BRIDGE_UART_NUM
        int "UART port connected to C6"
        default 1
        range 0 2
        depends on C6_BRIDGE_ENABLE

    config C6_BRIDGE_UART_TX
        int "UART TX GPIO (P4->C6 RX)"
        default 35
        range 0 56
        depends on C6_BRIDGE_ENABLE

    config C6_BRIDGE_UART_RX
        int "UART RX GPIO (P4<-C6 TX)"
        default 36
        range 0 56
        depends on C6_BRIDGE_ENABLE

    config C6_BRIDGE_BAUD
        int "Bridge baud"
        default 115200
        range 9600 2000000
        depends on C6_BRIDGE_ENABLE

    config C6_BRIDGE_RETRIGGER_BTN_GPIO
        int "Re-trigger button GPIO (long press forces C6 download)"
        default 4
        range 0 56
        depends on C6_BRIDGE_ENABLE

    config C6_BRIDGE_RETRIGGER_HOLD_MS
        int "Re-trigger hold time (ms)"
        default 2000
        range 200 10000
        depends on C6_BRIDGE_ENABLE

endmenu
```

## p4_sdio_flash/sdkconfig.defaults
```kconfig
CONFIG_IDF_TARGET="esp32p4"
CONFIG_LOG_DEFAULT_LEVEL_INFO=y
CONFIG_SERIAL_FLASHER_INTERFACE_SDIO=y

# Flash size
CONFIG_ESPTOOLPY_FLASHSIZE_16MB=y

# Partition table
CONFIG_PARTITION_TABLE_CUSTOM=y
CONFIG_PARTITION_TABLE_CUSTOM_FILENAME="partitions.csv"

# PSRAM - copy exact config from working main app
CONFIG_SPIRAM=y
CONFIG_SPIRAM_MODE_HEX=y
CONFIG_SPIRAM_SPEED_200M=y
CONFIG_SPIRAM_MEMTEST=n
CONFIG_SPIRAM_XIP_FROM_PSRAM=y
CONFIG_SPIRAM_FETCH_INSTRUCTIONS=y
CONFIG_SPIRAM_RODATA=y
CONFIG_SPIRAM_FLASH_LOAD_TO_PSRAM=y

# Cache - copy from main app
CONFIG_CACHE_L2_CACHE_256KB=y
CONFIG_CACHE_L2_CACHE_LINE_128B=y
```

## p4_sdio_flash_at/sdkconfig.defaults
```kconfig
CONFIG_IDF_TARGET="esp32p4"
CONFIG_LOG_DEFAULT_LEVEL_INFO=y

# Use UART interface instead of SDIO (more reliable for large binaries)
CONFIG_SERIAL_FLASHER_INTERFACE_UART=y

# Increase retries for large binary flashing
CONFIG_SERIAL_FLASHER_WRITE_BLOCK_RETRIES=10

# Enable MD5 check to detect corruption
CONFIG_SERIAL_FLASHER_MD5_ENABLED=y

# Debug tracing (optional - uncomment to debug)
# CONFIG_SERIAL_FLASHER_DEBUG_TRACE=y

# Flash size
CONFIG_ESPTOOLPY_FLASHSIZE_16MB=y

# Partition table
CONFIG_PARTITION_TABLE_CUSTOM=y
CONFIG_PARTITION_TABLE_CUSTOM_FILENAME="partitions.csv"

# PSRAM - copy exact config from working main app
CONFIG_SPIRAM=y
CONFIG_SPIRAM_MODE_HEX=y
CONFIG_SPIRAM_SPEED_200M=y
CONFIG_SPIRAM_MEMTEST=n
CONFIG_SPIRAM_XIP_FROM_PSRAM=y
CONFIG_SPIRAM_FETCH_INSTRUCTIONS=y
CONFIG_SPIRAM_RODATA=y
CONFIG_SPIRAM_FLASH_LOAD_TO_PSRAM=y

# Cache - copy from main app
CONFIG_CACHE_L2_CACHE_256KB=y
CONFIG_CACHE_L2_CACHE_LINE_128B=y
```

## sdkconfig.defaults.esp_hosted_disable
```kconfig
# Disable ESP-Hosted to allow UART communication with C6
CONFIG_ESP_HOSTED_ENABLED=n
```
